## components/optiga/Kconfig
```kconfig
menu "OPTIGA(TM) Trust M config"

	config OPTIGA_TRUST_M_CERT_SLOT
		hex
		default 0xE0E0 if OPTIGA_TRUST_M_CERT_SLOT0
		default 0xE0E1 if OPTIGA_TRUST_M_CERT_SLOT1
		default 0xE0E2 if OPTIGA_TRUST_M_CERT_SLOT2
		default 0xE0E3 if OPTIGA_TRUST_M_CERT_SLOT3

		choice 
			prompt "Select a certificate slot for authentication"
			default OPTIGA_TRUST_M_CERT_SLOT0
			help
				Four slots are supported, private keys 0xE0F0-0xE0F3 are used for these certificates

			config OPTIGA_TRUST_M_CERT_SLOT0
				bool "1st cert slot"
			config OPTIGA_TRUST_M_CERT_SLOT1
				bool "2nd cert slot"
			config OPTIGA_TRUST_M_CERT_SLOT2
				bool "3rd cert slot"
			config OPTIGA_TRUST_M_CERT_SLOT3
				bool "4th cert slot"
		endchoice
			
	config OPTIGA_TRUST_M_PRIVKEY_SLOT
		hex
		default 0xE0F0 if OPTIGA_TRUST_M_PRIVKEY_SLOT0
		default 0xE0F1 if OPTIGA_TRUST_M_PRIVKEY_SLOT1
		default 0xE0F2 if OPTIGA_TRUST_M_PRIVKEY_SLOT2
		default 0xE0F3 if OPTIGA_TRUST_M_PRIVKEY_SLOT3
		default 0xE0FC if OPTIGA_TRUST_M_RSA_PRIVKEY_SLOT0
		default 0xE0FD if OPTIGA_TRUST_M_RSA_PRIVKEY_SLOT1

		choice 
			prompt "Select a private key slot for authentication"
			default OPTIGA_TRUST_M_PRIVKEY_SLOT0
			help
				By default should correspond to a certificate slot

			config OPTIGA_TRUST_M_PRIVKEY_SLOT0
				bool "1st private key slot"
			config OPTIGA_TRUST_M_PRIVKEY_SLOT1
				bool "2nd private key slot"
			config OPTIGA_TRUST_M_PRIVKEY_SLOT2
				bool "3rd private key slot"
			config OPTIGA_TRUST_M_PRIVKEY_SLOT3
				bool "4th private key slot"
			config OPTIGA_TRUST_M_RSA_PRIVKEY_SLOT0
				bool "1st RSA private key slot"
			config OPTIGA_TRUST_M_RSA_PRIVKEY_SLOT1
				bool "2th RSA private key slot"
		endchoice

		
	config OPTIGA_TRUST_M_TRUSTANCHOR_SLOT
		hex
		default 0xE0E8 if OPTIGA_TRUST_M_TRUSTANCHOR_SLOT0
		default 0xE0E9 if OPTIGA_TRUST_M_TRUSTANCHOR_SLOT1
		default 0xE0EF if OPTIGA_TRUST_M_TRUSTANCHOR_SLOT2

		choice 
			prompt "Select a Trust Anchor slot for authentication"
			default OPTIGA_TRUST_M_TRUSTANCHOR_SLOT0
			help
				Three slots are supported for Trust Anchor

			config OPTIGA_TRUST_M_TRUSTANCHOR_SLOT0
				bool "1st Trust Anchor slot"
			config OPTIGA_TRUST_M_TRUSTANCHOR_SLOT1
				bool "2nd Trust Anchor slot"
			config OPTIGA_TRUST_M_TRUSTANCHOR_SLOT2
				bool "3rd Trust Anchor slot"
		endchoice

	menu "I2C pinout config"

		config PAL_I2C_INIT_ENABLE
			bool "Switch on i2c init for OPTIGA(TM) Trust M"
			default y
			help
				If you have more devices on the line and would like to disable 
				i2c interface initilisation within the driver use this option

		config PAL_I2C_MASTER_SCL_IO
			int "SCL pin number"
				depends on PAL_I2C_INIT_ENABLE
			default 16
			help
				SCL pin configuration, corresponds to GPIO number on the board

		config PAL_I2C_MASTER_SDA_IO
			int "SDA pin number"
				depends on PAL_I2C_INIT_ENABLE
			default 17
			help
				SDA pin configuration, corresponds to GPIO number on the board

		config PAL_I2C_MASTER_RESET
			int "Software reset pin number"
			default 23
			help
				Software reset pin configuration, corresponds to GPIO number on the board		
				
		config PAL_I2C_MASTER_NUM
			int "Master Instance on ESP"
				depends on PAL_I2C_INIT_ENABLE
			range 0 1
			default 0
			help
				I2C master instance number within ESP32 engine. 0 and 1 are supported

		config PAL_I2C_MASTER_FREQ_HZ
			int "I2C Baudrate"
				depends on PAL_I2C_INIT_ENABLE
			default 400000
			help
				Baudrate for the i2c interface. OPTIGA(TM) Trust M supports up to 1MHz	

	endmenu #I2C Configuration

	menu "mbedTLS Hardware Acceleration configuration"

		config OPTIGA_MBEDTLS_ECDSA_SIGN
			bool "Enable ECDSA signature generation support at OPTIGA Trust M"
			select MBEDTLS_ECDSA_SIGN_ALT
			select MBEDTLS_ECP_DP_SECP256R1_ENABLED

		config OPTIGA_MBEDTLS_ECDSA_VERIFY
			bool "Enable ECDSA signature verification support at OPTIGA Trust M"
			select MBEDTLS_ECDSA_VERIFY_ALT
			select MBEDTLS_ECP_DP_SECP256R1_ENABLED

		config OPTIGA_MBEDTLS_ECDHE
			bool "Enable ECDHE support at OPTIGA Trust M"
			select MBEDTLS_ECDH_GEN_PUBLIC_ALT
			select MBEDTLS_ECDH_COMPUTE_SHARED_ALT
			select MBEDTLS_ECP_DP_SECP256R1_ENABLED

		config OPTIGA_MBEDTLS_RSA
			bool "Enable RSA support at OPTIGA Trust M"
			select MBEDTLS_RSA_ALT

	endmenu #mbedTLS Hardware Acceleration configuration
		
endmenu  # OPTIGA(TM) Trust M
```

## components/optiga/Kconfig.projbuild
```kconfig
menu "OPTIGA(TM) Trust M config"

	config OPTIGA_TRUST_M_CERT_SLOT
		hex
		default 0xE0E0 if OPTIGA_TRUST_M_CERT_SLOT0
		default 0xE0E1 if OPTIGA_TRUST_M_CERT_SLOT1
		default 0xE0E2 if OPTIGA_TRUST_M_CERT_SLOT2
		default 0xE0E3 if OPTIGA_TRUST_M_CERT_SLOT3

		choice 
			prompt "Select a certificate slot for authentication"
			default OPTIGA_TRUST_M_CERT_SLOT0
			help
				Four slots are supported, private keys 0xE0F0-0xE0F3 are used for these certificates

			config OPTIGA_TRUST_M_CERT_SLOT0
				bool "1st cert slot"
			config OPTIGA_TRUST_M_CERT_SLOT1
				bool "2nd cert slot"
			config OPTIGA_TRUST_M_CERT_SLOT2
				bool "3rd cert slot"
			config OPTIGA_TRUST_M_CERT_SLOT3
				bool "4th cert slot"
		endchoice
			
	config OPTIGA_TRUST_M_PRIVKEY_SLOT
		hex
		default 0xE0F0 if OPTIGA_TRUST_M_PRIVKEY_SLOT0
		default 0xE0F1 if OPTIGA_TRUST_M_PRIVKEY_SLOT1
		default 0xE0F2 if OPTIGA_TRUST_M_PRIVKEY_SLOT2
		default 0xE0F3 if OPTIGA_TRUST_M_PRIVKEY_SLOT3
		default 0xE0FC if OPTIGA_TRUST_M_RSA_PRIVKEY_SLOT0
		default 0xE0FD if OPTIGA_TRUST_M_RSA_PRIVKEY_SLOT1

		choice 
			prompt "Select a private key slot for authentication"
			default OPTIGA_TRUST_M_PRIVKEY_SLOT0
			help
				By default should correspond to a certificate slot

			config OPTIGA_TRUST_M_PRIVKEY_SLOT0
				bool "1st private key slot"
			config OPTIGA_TRUST_M_PRIVKEY_SLOT1
				bool "2nd private key slot"
			config OPTIGA_TRUST_M_PRIVKEY_SLOT2
				bool "3rd private key slot"
			config OPTIGA_TRUST_M_PRIVKEY_SLOT3
				bool "4th private key slot"
			config OPTIGA_TRUST_M_RSA_PRIVKEY_SLOT0
				bool "1st RSA private key slot"
			config OPTIGA_TRUST_M_RSA_PRIVKEY_SLOT1
				bool "2th RSA private key slot"
		endchoice

		
	config OPTIGA_TRUST_M_TRUSTANCHOR_SLOT
		hex
		default 0xE0E8 if OPTIGA_TRUST_M_TRUSTANCHOR_SLOT0
		default 0xE0E9 if OPTIGA_TRUST_M_TRUSTANCHOR_SLOT1
		default 0xE0EF if OPTIGA_TRUST_M_TRUSTANCHOR_SLOT2

		choice 
			prompt "Select a Trust Anchor slot for authentication"
			default OPTIGA_TRUST_M_TRUSTANCHOR_SLOT0
			help
				Three slots are supported for Trust Anchor

			config OPTIGA_TRUST_M_TRUSTANCHOR_SLOT0
				bool "1st Trust Anchor slot"
			config OPTIGA_TRUST_M_TRUSTANCHOR_SLOT1
				bool "2nd Trust Anchor slot"
			config OPTIGA_TRUST_M_TRUSTANCHOR_SLOT2
				bool "3rd Trust Anchor slot"
		endchoice
		
endmenu  # OPTIGA(TM) Trust M
```

## examples/iothub_client_sample_mqtt/main/Kconfig.projbuild
```kconfig
menu "Example Configuration"

config WIFI_SSID
    string "WiFi SSID"
	default "myssid"
	help
		SSID (network name) for the example to connect to.

config WIFI_PASSWORD
    string "WiFi Password"
	default "myssid"
	help
		WiFi password (WPA or WPA2) for the example to use.

		Can be left blank if the network has no security set.

config IOTHUB_CONNECTION_STRING
    string "IOT Hub Device Connection String"
	default "HostName=<host_name>;DeviceId=<device_id>;SharedAccessKey=<device_key>"
	help
		String containing Hostname, Device Id & Device Key in the format:
		
		HostName=<host_name>;DeviceId=<device_id>;SharedAccessKey=<device_key>
		HostName=<host_name>;DeviceId=<device_id>;SharedAccessSignature=<device_sas_token>

		You can get this from the iothub-explorer CLI or the Azure Portal

config RSA_KEY_SIZE
    hex
		default 0x41 if RSA_1024
		default 0x42 if RSA_2048
		
	choice 
	prompt "Select a RSA key used of device certficate"
	default RSA_1024
		help
			By default should correspond to RSA 1024 key size

		config RSA_1024
			bool "RSA key 1024"
		config RSA_2048
			bool "RSA key 2048"
	endchoice

config MESSAGE_INTERVAL_TIME
    int "Time delay in Milliseconds between two consecutive messages"
    default 100
    help
        Set time delay between two consecutive message sent to the cloud

config MESSAGE_COUNT
    int "Total number of messages to be sent to the cloud"
    default 50
    help
        This example will terminate after sending these many
        messages. If the message count is set as 0 then this example
        will send indefinite messages to the cloud.

endmenu
```
